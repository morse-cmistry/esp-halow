## firmware/Kconfig
```kconfig
# Copyright 2024-2026 Morse Micro
# SPDX-License-Identifier: Apache-2.0
menu "Morse Micro Firmware Configuration"
    config MM_BCF_FILE
        string "Morse Micro Board Configuration File"
        default "bcf_fgh100mhaamd.mbin"
        help
            Set the name of the BCF (Board Configuration File) to use.
            Example valid filenames include:
              - bcf_mf08651_us.mbin
              - bcf_mf08551.mbin
              - bcf_mf08251.mbin
              - bcf_mf03120.mbin

            This file provides board-specific configuration data for the Morse Micro chip/module.

            The build system will search for the specified file in the following locations:
              1. firmware/ in the root of the application being built

            If the file is not found in either location, a warning will be reported during
            configuration.

    choice MM_CHIP
        bool "Morse Micro Chip Variant"
        optional
        help
            This is used for selecting HAL calls and selecting firmware.

        config MM_CHIP_MM6108
            bool "Morse Micro mm6108"
        config MM_CHIP_MM8108
            bool "Morse Micro mm8108"
    endchoice

endmenu
```

## halow/Kconfig
```kconfig
# Copyright 2025-2026 Morse Micro
# SPDX-License-Identifier: Apache-2.0

rsource "components/mmpktmem/Kconfig"
rsource "components/shims/Kconfig"

menu "Wi-Fi HaLow Connection Manager"

    config HALOW_COUNTRY_CODE
        string "Country code to use for Wi-Fi HaLow"
        default "??"

	config HALOW_PS_MODE
		bool "Enable Morse Micro HaLow Powersave Mode"
		default false
		help
			This can only be set to true for devices which have the BUSY and WAKE
			pins connected.

endmenu
```

## halow/components/firmware/Kconfig
```kconfig
# Copyright 2024-2026 Morse Micro
# SPDX-License-Identifier: Apache-2.0
menu "Morse Micro Firmware Configuration"
    config MM_BCF_FILE
        string "Morse Micro Board Configuration File"
        help
            Set the name of or relative path to the BCF (Board Configuration File).

            .bin files will be converted to .mbin (based on file extension).

            Example valid filenames include:
              - bcf_mf08651_us.bin
              - bcf_mf08551.bin
              - bcf_mf08251.mbin
              - bcf_mf03120.mbin

            This file provides board-specific configuration data for the Morse Micro chip/module.

            The build system will search for the specified file in the following locations:
              1. the relative path from the project root
              2. managed_components/morsemicro__halow/components/firmware

            If a file is not found, an error will be thrown when building.

    choice MM_CHIP
        bool "Morse Micro Chip Variant"
        optional
        help
            This is used for selecting HAL calls and selecting firmware.

        config MM_CHIP_MM6108
            bool "Morse Micro mm6108"
        config MM_CHIP_MM8108
            bool "Morse Micro mm8108"
    endchoice

endmenu
```

## halow/components/shims/Kconfig
```kconfig
# Copyright 2024-2026 Morse Micro
# SPDX-License-Identifier: Apache-2.0
menu "Morse Micro Shim Configuration"
    config MM_RESET_N
        int "RESET_N pin for MM chip"
        default -1
        help
            Output gpio pin used to control the RESET_N line.

    config MM_WAKE
        int "WAKE pin for MM chip"
        default -1
        help
            Output gpio pin used to control the WAKE line.

    config MM_BUSY
        int "BUSY pin for the MM chip"
        default -1
        help
            Input pin used as a rising edge interrupt.

    config MM_SPI_SCK
        int "SCK pin for MM chip"
        default -1
        help
            SPI clock pin.

    config MM_SPI_MOSI
        int "MOSI pin for MM chip"
        default -1
        help
            SPI master out slave in pin.

    config MM_SPI_MISO
        int "MISO pin for MM chip"
        default -1
        help
            SPI master in slave out pin.

    config MM_SPI_CS
        int "SPI CS pin for MM chip"
        default -1
        help
            SPI chip select pin.

    config MM_SPI_IRQ
        int "SPI IRQ pin for MM chip"
        default -1
        help
            Out of band interupt pin used to indicate that
            the MM chip has data for the host.

endmenu
```

## halow/configs/sdkconfig.defaults.seeed_xiao_esp32c5-seeed_xiao_mm6108
```kconfig
# BOARD: Seeed XIAO ESP32C5
# HAT: Seeed XIAO WM6108

# Pin configuration
CONFIG_MM_RESET_N=1
CONFIG_MM_WAKE=3
CONFIG_MM_BUSY=23
CONFIG_MM_SPI_SCK=8
CONFIG_MM_SPI_MOSI=10
CONFIG_MM_SPI_MISO=9
CONFIG_MM_SPI_CS=7
CONFIG_MM_SPI_IRQ=25

# Morse Micro chip configuration
CONFIG_MM_BCF_FILE="bcf_fgh100mhaamd.bin"
CONFIG_MM_CHIP_MM6108=y
```

## halow/configs/sdkconfig.defaults.seeed_xiao_esp32c6-seeed_xiao_mm6108
```kconfig
# BOARD: Seeed XIAO ESP32C6
# HAT: Seeed XIAO WM6108

# Pin configuration
CONFIG_MM_RESET_N=0
CONFIG_MM_WAKE=1
CONFIG_MM_BUSY=22
CONFIG_MM_SPI_SCK=19
CONFIG_MM_SPI_MOSI=18
CONFIG_MM_SPI_MISO=20
CONFIG_MM_SPI_CS=21
CONFIG_MM_SPI_IRQ=2

# Morse Micro chip configuration
CONFIG_MM_BCF_FILE="bcf_fgh100mhaamd.mbin"
CONFIG_MM_CHIP_MM6108=y
```

## halow/configs/sdkconfig.defaults.seeed_xiao_esp32s3-seeed_xiao_mm6108
```kconfig
# BOARD: Seeed XIAO ESP32S3
# HAT: Seeed XIAO WM6108

# Pin configuration
CONFIG_MM_RESET_N=1
CONFIG_MM_WAKE=2
CONFIG_MM_BUSY=5
CONFIG_MM_SPI_SCK=7
CONFIG_MM_SPI_MOSI=9
CONFIG_MM_SPI_MISO=8
CONFIG_MM_SPI_CS=4
CONFIG_MM_SPI_IRQ=3

# Morse Micro chip configuration
CONFIG_MM_BCF_FILE="bcf_fgh100mhaamd.mbin"
CONFIG_MM_FW_FILE="mm6108.mbin"
CONFIG_MM_CHIP_MM6108=y
```

## halow/configs/sdkconfig.defaults.waveshare_esp32p4_devkit-morsemicro_mmech06_mm6108
```kconfig
# BOARD: Waveshare ESP32P4 Dev Kit
# HAT: Morse Micro MMECH06 MM6108

# Pin configuration
CONFIG_MM_RESET_N=24
CONFIG_MM_WAKE=23
CONFIG_MM_BUSY=32
CONFIG_MM_SPI_SCK=0
CONFIG_MM_SPI_MOSI=3
CONFIG_MM_SPI_MISO=2
CONFIG_MM_SPI_CS=36
CONFIG_MM_SPI_IRQ=1

# Morse Micro chip configuration
CONFIG_MM_BCF_FILE="bcf_mf08651_us.bin"
CONFIG_MM_CHIP_MM6108=y
```

## halow/configs/sdkconfig.defaults.waveshare_esp32p4_devkit-morsemicro_mmech17_mm8108
```kconfig
# BOARD: Waveshare ESP32P4 Dev Kit
# HAT: Morse Micro MMECH17 MM8108

# Pin configuration
CONFIG_MM_RESET_N=33
CONFIG_MM_WAKE=23
CONFIG_MM_BUSY=32
CONFIG_MM_SPI_SCK=0
CONFIG_MM_SPI_MOSI=3
CONFIG_MM_SPI_MISO=2
CONFIG_MM_SPI_CS=36
CONFIG_MM_SPI_IRQ=1

# Morse Micro chip configuration
CONFIG_MM_BCF_FILE="bcf_mf15457.mbin"
CONFIG_MM_CHIP_MM8108=y

# ESP32P4 needs explicit crypto support
CONFIG_MBEDTLS_CMAC_C=y
```

## halow/examples/dual_if/main/Kconfig.projbuild
```kconfig
# Copyright 2026 Morse Micro
#
# SPDX-License-Identifier: Apache-2.0

menu "HaLow dual_if Example Configuration"

config HALOW_SSID
	string "Wi-Fi SSID"
	default "MorseMicro"

config HALOW_PSK
	string "Wi-Fi Password"
	default "12345678"

endmenu
```

## halow/examples/iperf/main/Kconfig.projbuild
```kconfig
# Copyright 2026 Morse Micro
#
# SPDX-License-Identifier: Apache-2.0

menu "HaLow iperf Example Configuration"

config WIFI_SSID
	string "Wi-Fi SSID"
	default "MorseMicro"

config WIFI_PSK
	string "Wi-Fi Password"
	default "12345678"

endmenu
```

## halow/examples/sta_connect/main/Kconfig.projbuild
```kconfig
# Copyright 2026 Morse Micro
#
# SPDX-License-Identifier: Apache-2.0

menu "HaLow sta_connect Example Configuration"

config WIFI_SSID
	string "Wi-Fi SSID"
	default "MorseMicro"

config WIFI_PSK
	string "Wi-Fi Password"
	default "12345678"

endmenu
```

## mmhalow/Kconfig
```kconfig
menu "Wi-Fi HaLow Connection Manager"

    config HALOW_COUNTRY_CODE
        string "Country code to use for Wi-Fi HaLow"
        default "??"

	config HALOW_PS_MODE
		bool "Enable Halow Powersave Mode"
		default false
		help
			This can only be set to true for devices which have the BUSY and WAKE
			pins connected.

endmenu
```

## samples/sta_connect/main/Kconfig.projbuild
```kconfig
config WIFI_SSID
	string "Wi-Fi SSID"
	default "MorseMicro"

config WIFI_PSK
	string "Wi-Fi Password"
	default "12345678"
```

## shims/Kconfig
```kconfig
# Copyright 2024 Morse Micro
# SPDX-License-Identifier: Apache-2.0
menu "Morse Micro Shim Configuration"
    config MM_RESET_N
        int "RESET_N pin for MM chip"
        default 1
        help
            Output gpio pin used to control the RESET_N line.

    config MM_WAKE
        int "WAKE pin for MM chip"
        default 2
        help
            Output gpio pin used to control the WAKE line.

    config MM_BUSY
        int "BUSY pin for the MM chip"
        default 5
        help
            Input pin used as a rising edge interrupt.

    config MM_SPI_SCK
        int "SCK pin for MM chip"
        default 7
        help
            SPI clock pin.

    config MM_SPI_MOSI
        int "MOSI pin for MM chip"
        default 9
        help
            SPI master out slave in pin.

    config MM_SPI_MISO
        int "MISO pin for MM chip"
        default 8
        help
            SPI master in slave out pin.

    config MM_SPI_CS
        int "SPI CS pin for MM chip"
        default 4
        help
            SPI chip select pin.

    config MM_SPI_IRQ
        int "SPI IRQ pin for MM chip"
        default 3
        help
            Out of band interupt pin used to indicate that
            the MM chip has data for the host.

    config MM_BCF
        string "BCF to link when building the FW"
        default "mf08651_us"
        help
            The Board Configuration File (BCF) is a configuration file for the Morse Micro chip that provides
            board-specific information and is required for the system to function properly. BCFs for Morse Micro
            modules are included in the MM-IoT-SDK package. These modules can be identified by the part numbers
            printed on their labels, which take the form MM6108-MFxxxxxx.
    config MMOSAL_TASK_PRI_IDLE
        int "Priority level for IDLE threads started by the Morse Micro libraries"
        default 0
    config MMOSAL_TASK_PRI_MIN
        int "Priority level for MIN threads started by the Morse Micro libraries"
        default 1
    config MMOSAL_TASK_PRI_LOW
        int "Priority level for LOW threads started by the Morse Micro libraries"
        default 2
    config MMOSAL_TASK_PRI_NORM
        int "Priority level for NORM threads started by the Morse Micro libraries"
        default 3
    config MMOSAL_TASK_PRI_HIGH
        int "Priority level for HIGH threads started by the Morse Micro libraries"
        default 4

endmenu
```
